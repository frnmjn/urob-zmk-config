/* source key position labels */
#include "zmk-helpers/key-labels/36.h"

/* activate bluetooth */
#define CONFIG_WIRELESS

/* source the main keymap */
#include "base.keymap"

ZMK_APPLY_MATRIX_TRANSFORM(default_transform)
